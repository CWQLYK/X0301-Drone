// 作者：咸
// 电话:18878881386
// 邮箱:3078510877@qq.com
// 日期：2026.3.10
// 版本：1.0
//  遥控器数据解析
#include "ALL_DEFINE.h"
#include <math.h>           

// 全局标志位
u16 test_flag;              // 测试功能标志位（预留扩展）
u16 set_flag;               // 参数设置标志位（预留扩展）

/*****************************************************************************************
 * 函数名: Rc_Connect
 * 功能:  遥控器通信连接检测
 * 描述:  优先检测NRF24L01 2.4G遥控器连接，连接成功后再尝试WIFI图传连接
 * 输入:  无
 * 输出:  无
 * 返回值: 无
 ******************************************************************************************/
void Rc_Connect(void)
{
    // 连接检测优先级:
    if(NRF_Connect() == 0)  // 检测到NRF24L01连接（0表示连接成功）
    {
        
    }
}

/*****************************************************************************************
 * 全局变量定义
 ******************************************************************************************/
uint8_t RC_rxData[32];      // 遥控器接收数据缓冲区（32字节，适配NRF24L01数据包长度）
void remote_unlock(void);   // 遥控器解锁/上锁逻辑声明

/*****************************************************************************************
 * 函数名: RC_Analy
 * 功能:  遥控器数据解析与异常处理
 * 描述: 
 *  1. 解析遥控器通道数据，将横滚/俯仰/偏航/油门转换为PID控制目标值
 *  2. 检测遥控器失联状态，失联时执行安全逻辑（自动上锁/参数复位）
 * 输入:  无（依赖全局Remote结构体）
 * 输出:  无（修改全局PID控制器目标值/Remote结构体）
 * 返回值: 无
 ******************************************************************************************/
void RC_Analy(void)
{
    static uint16_t cnt;    // 遥控器失联计数（单位：控制周期，约3ms/次）
    static uint16_t cnt_tmp;// 油门缓降计数（失联时油门逐步降低）

    /* 遥控器数据有效状态处理 */
    // 判断NRF模块 或 WIFI模块是否有一个模块接收到有效数据
    if(Nrf_Erro == 1)
    {
        // 通道数据转PID目标值系数（遥控器1000-2000为标准范围）
        const float roll_pitch_ratio = 0.04f;  // 横滚/俯仰通道转换系数
        const float yaw_ratio = 0.0015f;       // 偏航通道转换系数（预留未直接使用）

        // 计算横滚PID目标值：遥控器值1500为中位，反向转换（负号适配摇杆方向）
        pidRoll.desired = -(Remote.roll - 1500) * roll_pitch_ratio;
        // 计算俯仰PID目标值：同横滚逻辑
        pidPitch.desired = -(Remote.pitch - 1500) * roll_pitch_ratio;

        // 偏航通道为增量式控制：遥控器偏航摇杆超出阈值时，直接调整PID目标值
        if(Remote.yaw > 1820)        // 偏航摇杆向右（数值>1820）
        {
            pidYaw.desired -= 0.75f; // 偏航PID目标值减小（顺时针旋转）
        }
        else if(Remote.yaw < 1180)   // 偏航摇杆向左（数值<1180）
        {
            pidYaw.desired += 0.75f; // 偏航PID目标值增大（逆时针旋转）
        }

        remote_unlock(); // 执行遥控器解锁逻辑，判断是否满足解锁/上锁条件
    }
    // 遥控器失联处理：连续3秒未收到有效数据（800个控制周期，约2.4秒）触发安全逻辑
    // 安全逻辑：自动复位通道值+关闭电机+复位传感器+LED报警
    else
    {
        cnt++; // 失联计数累加
        if(cnt > 800) // 超过800个周期判定为失联
        {
            // 复位横滚通道值为1500中位，限幅1000-2000防止越界
            Remote.roll = 1500;
            LIMIT(Remote.roll, 1000, 2000);
            // 复位俯仰通道值
            Remote.pitch = 1500;
            LIMIT(Remote.pitch, 1000, 2000);
            // 复位偏航通道值
            Remote.yaw = 1500;
            LIMIT(Remote.yaw, 1000, 2000);

            // 油门通道判断：油门低于1030时执行紧急上锁
            if(Remote.thr < 1030)
            {
                cnt = 0;               // 清零失联计数
                Remote.thr = 1000;     // 油门复位至最小值
                ALL_flag.unlock = 0;   // 关闭解锁状态
                LED.status = AllFlashLight; // LED全闪报警
                NRF24L01_init();       // 复位NRF24L01模块（重新尝试连接）
            }
            // 油门高于1030时，逐步降低油门防止突然停机
            else
            {
                cnt = 810; // 固定计数避免重复触发初始化
                if(cnt_tmp++ > 100) // 每100个周期（约0.3秒）降低一次
                {
                    cnt_tmp = 0;
                    Remote.thr = Remote.thr - 20; // 每次降低20（缓降油门）
                }
            }
            LIMIT(Remote.thr, 1000, 2000); // 油门限幅防止超出最小值/最大值
        }
    }
}

/*****************************************************************************************
 * 函数名: remote_unlock
 * 功能:  遥控器解锁/上锁核心逻辑
 * 描述: 
 *  1. 状态机实现解锁流程：等待→验证1→验证2→解锁→运行→退出
 *  2. 上锁条件：无操作6秒/油门过低/偏航摇杆右打
 *  3. 支持解锁组合动作：油门最低+偏航摇杆右打
 * 输入:  无（依赖全局Remote结构体/ALL_flag标志位）
 * 输出:  无（修改解锁标志位/LED状态）
 * 返回值: 无
 ******************************************************************************************/
void remote_unlock(void)
{
    volatile static uint8_t status = WAITING_1; // 解锁状态机，初始为等待状态
    static uint16_t cnt = 0;                    // 计时计数器（单位：控制周期）

    // 强制上锁条件：油门低于1200 且 偏航摇杆右打>1800
    if(Remote.thr < 1200 && Remote.yaw > 1800)
    {
        status = EXIT_255; // 强制进入上锁状态
    }

    // 解锁状态机逻辑
    switch(status)
    {
        case WAITING_1: // 等待状态1：检测油门低于1150（解锁第一步）
            if(Remote.thr < 1150)
            {
                status = WAITING_2; // 进入等待状态2
            }
            break;

        case WAITING_2: // 等待状态2：检测油门高于1800（解锁第二步）
            if(Remote.thr > 1800)
            {
                static uint8_t cnt = 0;
                cnt++; // 计数防抖（防止误触发）
                // 持续5个周期（约15ms）确认后进入下一步
                if(cnt > 5)
                {
                    cnt = 0;
                    status = WAITING_3; // 进入等待状态3
                }
            }
            break;

        case WAITING_3: // 等待状态3：检测油门再次低于1150（解锁第三步）
            if(Remote.thr < 1150)
            {
                status = WAITING_4; // 进入解锁成功状态
            }
            break;

        case WAITING_4: // 解锁成功状态
            ALL_flag.unlock = 1;    // 设置全局解锁标志位
            status = PROCESS_31;    // 进入运行状态
            LED.status = AlwaysOn;  // LED常亮表示解锁成功
            break;

        case PROCESS_31: // 正常运行状态
            // 超时判断：油门低于1020且持续2000个周期（约6秒）
            if(Remote.thr < 1020)
            {
                if(cnt++ > 2000)
                {
                    status = EXIT_255; // 进入上锁状态
                }
            }
            // 外部解锁标志位被清除时上锁
            else if(!ALL_flag.unlock)
            {
                status = EXIT_255;
            }
            // 正常状态下清零计时
            else
            {
                cnt = 0;
            }
            break;

        case EXIT_255: // 上锁状态（初始化/故障/超时）
            LED.status = AllFlashLight; // LED全闪报警
            cnt = 0;                    // 清零计时
            LED.FlashTime = 300;        // LED闪烁周期（300*3ms=900ms）
            ALL_flag.unlock = 0;        // 清除解锁标志位
            status = WAITING_1;         // 回到初始等待状态
            break;

        default: // 异常状态：强制上锁
            status = EXIT_255;
            break;
    }
}